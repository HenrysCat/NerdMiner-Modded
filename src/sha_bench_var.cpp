// Loop-variant harness for the SHA bench (-D SHA_BENCH=2).
//
// Runs every instance of the PL_MINE macro listed in sha_bench_variants.inc
// (src/pipelined_hw_sha_classic_v2.S; generated by
// tools/sha_bench/gen_variants.py) over the same 40000 nonces and checks
// every single hash against software: the loop sums the digest word it
// samples, and that sum has to match chunk by chunk. Each pass runs with a
// different kind of bus traffic on core 0, because that is what breaks a
// schedule that looks fine on a quiet chip.
//
// Output, one line per variant and pass (tools/sha_bench/summarize.py):
//   V <idx> OK|BAD <cycles per nonce> A<bad> B<bad> C<bad>
//     A: all 40000 nonces in one go, interrupts off (this is the timing run)
//     B: the same in 80 chunks of 500, i.e. 80 cold starts
//     C: like A with interrupts on
//   K <idx> ...  only when something is wrong: one nonce per call, then TEXT
//     is read back -- a word that isn't the header word that was stored
//     last is a store the hardware dropped.
#if defined(SHA_BENCH) && SHA_BENCH == 2

#include <Arduino.h>
#include <soc/dport_reg.h>
#include <soc/hwcrypto_reg.h>
#include <driver/periph_ctrl.h>

struct pl_ctx_t
{
    uint32_t hdr[20];
    uint32_t nonce;
    uint32_t budget;
    volatile uint32_t run;
    uint32_t pad;
    uint32_t chk;
};

#include "sha_bench_variants.h"

extern const uint32_t IV256[8];
void sb_compress(uint32_t st[8], const uint32_t in[16]);

#define SB ((volatile uint32_t *)SHA_TEXT_BASE)
#define VAR_N 40000u
#define VAR_NONCE0 0x1234ABCDu
#define NVAR (sizeof(s_variants) / sizeof(s_variants[0]))

static uint32_t s_hdr[20];
static uint16_t *s_ref = NULL; // low 16 bits of the last digest word, per nonce

static void var_reference()
{
    uint32_t x = 0x9E3779B9u;
    for (int i = 0; i < 20; ++i)
    {
        x ^= x << 13; x ^= x >> 17; x ^= x << 5;
        s_hdr[i] = x;
    }
    uint32_t mid[8];
    memcpy(mid, IV256, sizeof(mid));
    sb_compress(mid, s_hdr);
    s_ref = (uint16_t *)malloc(VAR_N * sizeof(uint16_t));
    uint32_t hits = 0;
    for (uint32_t n = 0; n < VAR_N; ++n)
    {
        uint32_t b2[16] = {s_hdr[16], s_hdr[17], s_hdr[18], VAR_NONCE0 + n, 0x80000000u, 0, 0, 0, 0, 0, 0, 0, 0, 0, 0, 640};
        uint32_t d1[8];
        memcpy(d1, mid, sizeof(d1));
        sb_compress(d1, b2);
        uint32_t b3[16] = {d1[0], d1[1], d1[2], d1[3], d1[4], d1[5], d1[6], d1[7], 0x80000000u, 0, 0, 0, 0, 0, 0, 256};
        uint32_t d2[8];
        memcpy(d2, IV256, sizeof(d2));
        sb_compress(d2, b3);
        s_ref[n] = (uint16_t)d2[7];
        if (s_ref[n] == 0) hits++;
        if ((n & 0x3FF) == 0) vTaskDelay(1);
    }
    Serial.printf("V reference ready: N=%u candidates=%u\n", VAR_N, hits);
}

static void ctx_init(pl_ctx_t &ctx)
{
    memcpy(ctx.hdr, s_hdr, sizeof(ctx.hdr));
    ctx.run = 1;
    ctx.pad = 0x80000000u;
}

// Returns the number of chunks whose checksum (or bookkeeping) was wrong.
static uint32_t var_run(int idx, uint32_t chunk, bool irq_off, uint32_t *cyc_out)
{
    static pl_ctx_t ctx;
    ctx_init(ctx);
    uint32_t bad = 0, cyc = 0;
    periph_module_reset(PERIPH_SHA_MODULE);
    for (uint32_t start = 0; start < VAR_N; start += chunk)
    {
        uint32_t want = 0;
        for (uint32_t n = start; n < start + chunk; ++n) want += s_ref[n];
        ctx.nonce = VAR_NONCE0 + start;
        ctx.budget = chunk;
        ctx.chk = 0;
        uint32_t calls = 0;
        if (irq_off) portDISABLE_INTERRUPTS();
        uint32_t c0 = xthal_get_ccount();
        while (ctx.budget > 0 && calls < 500)
        {
            s_variants[idx].fn(SB, &ctx);
            calls++;
        }
        cyc += xthal_get_ccount() - c0;
        if (irq_off) portENABLE_INTERRUPTS();
        // every call adds 1 for its cold start ("no candidate yet")
        if (ctx.chk - calls != want || ctx.budget != 0 || ctx.nonce != VAR_NONCE0 + start + chunk) bad++;
    }
    *cyc_out = cyc;
    return bad;
}

static void var_lost_stores(int idx, uint32_t count)
{
    static pl_ctx_t ctx;
    ctx_init(ctx);
    uint32_t nBad = 0, nLost = 0;
    uint32_t word[16] = {0};
    periph_module_reset(PERIPH_SHA_MODULE);
    for (uint32_t n = 0; n < count; ++n)
    {
        ctx.nonce = VAR_NONCE0 + n;
        ctx.budget = 1;
        ctx.chk = 0;
        portDISABLE_INTERRUPTS();
        s_variants[idx].fn(SB, &ctx);
        portENABLE_INTERRUPTS();
        // The loop returns with block 1 of the next nonce in TEXT.
        bool lost = false;
        for (int i = 0; i < 16; ++i)
        {
            uint32_t a = SB[i], b = SB[i], c = SB[i];
            if (((a == b || a == c) ? a : b) != s_hdr[i]) { word[i]++; lost = true; }
        }
        if (lost) nLost++;
        if (ctx.chk - 1 != s_ref[n]) nBad++;
    }
    if (!nBad && !nLost) return;
    Serial.printf("K %d wrong=%u/%u calls-with-lost-store=%u per TEXT word:", idx, nBad, count, nLost);
    for (int i = 0; i < 16; ++i) Serial.printf(" %u", word[i]);
    Serial.println();
}

// Core-0 load: one kind of bus traffic per mode, as dense as it gets.
static volatile int s_mode = 0;
static const char *const s_modeName[] = {
    "quiet", "DPORT read", "APB read", "APB write", "DPORT write", "esp-idf mix",
    "DPORT write burst", "DPORT read burst", "DPORT write/read burst"};
#define NMODE (sizeof(s_modeName) / sizeof(s_modeName[0]))

static void IRAM_ATTR stress_task(void *)
{
    volatile uint32_t sink = 0;
    volatile uint32_t *const dportRd = (volatile uint32_t *)DPORT_PERI_CLK_EN_REG;
    volatile uint32_t *const dportWr = (volatile uint32_t *)0x3FF000C8; // DPORT_CPU_INTR_FROM_CPU_3_REG, unused; 0 = no-op
    volatile uint32_t *const apbRd = (volatile uint32_t *)0x3FF44004;   // GPIO_OUT_REG
    volatile uint32_t *const apbWr = (volatile uint32_t *)0x3FF4400C;   // GPIO_OUT_W1TC_REG; no bits = no-op
    for (;;)
    {
        int m = s_mode;
        if (m == 0) { vTaskDelay(2); continue; }
        for (int i = 0; i < 20000; ++i)
        {
            uint32_t z = 0, t = 0;
            switch (m)
            {
            case 1: sink += *dportRd; break;
            case 2: sink += *apbRd; break;
            case 3: *apbWr = 0; break;
            case 4: *dportWr = 0; break;
            case 5: sink += micros() + *apbRd + DPORT_REG_READ(DPORT_PERI_CLK_EN_REG); break;
            case 6:
                __asm__ __volatile__(".rept 16\n s32i.n %[z], %[r], 0\n .endr\n" : : [z] "r"(z), [r] "r"(dportWr) : "memory");
                break;
            case 7:
                __asm__ __volatile__(".rept 16\n l32i.n %[t], %[r], 0\n .endr\n" : [t] "=&r"(t) : [r] "r"(dportRd) : "memory");
                break;
            case 8:
                __asm__ __volatile__(".rept 8\n s32i.n %[z], %[r], 0\n l32i.n %[t], %[r], 0\n .endr\n"
                                     : [t] "=&r"(t) : [z] "r"(z), [r] "r"(dportWr) : "memory");
                break;
            }
            sink += t;
        }
        vTaskDelay(1);
    }
}

void sha_bench_variants_pass()
{
    static uint32_t pass = 0;
    if (!s_ref)
    {
        var_reference();
        xTaskCreatePinnedToCore(stress_task, "Stress", 4096, NULL, 1, NULL, 0);
    }
    s_mode = pass % NMODE;
    vTaskDelay(20);
    Serial.printf("P pass=%u stress=%d (%s)\n", pass, (int)s_mode, s_modeName[s_mode]);
    for (unsigned i = 0; i < NVAR; ++i)
    {
        uint32_t cyc = 0, unused = 0;
        var_run(i, VAR_N, true, &unused); // warms the flash cache for variants placed there
        uint32_t badA = var_run(i, VAR_N, true, &cyc);
        uint32_t badB = var_run(i, 500, true, &unused);
        uint32_t badC = var_run(i, VAR_N, false, &unused);
        Serial.printf("V %3u %s %u.%02u A%u B%u C%u\n", i, (badA | badB | badC) ? "BAD" : "OK ",
                      cyc / VAR_N, (uint32_t)(((uint64_t)cyc * 100 / VAR_N) % 100), badA, badB, badC);
        var_lost_stores(i, 2000);
        vTaskDelay(1);
    }
    pass++;
}

#endif
